## conf/layer.conf
```bitbake
# We have a conf and classes directory, add to BBPATH
BBPATH .= ":${LAYERDIR}"

# We have recipes-* directories, add to BBFILES
BBFILES += "${LAYERDIR}/recipes-*/*/*.bb \
            ${LAYERDIR}/recipes-*/*/*.bbappend"

BBFILE_COLLECTIONS += "meta-noto"
BBFILE_PATTERN_meta-noto = "^${LAYERDIR}/"
BBFILE_PRIORITY_meta-noto = "6"

LAYERDEPENDS_meta-noto = "core"
# meta-noto now has branches for each release. Switch your meta-noto branches
# to the released branches for production builds. 
LAYERSERIES_COMPAT_meta-noto = "honister"
```
